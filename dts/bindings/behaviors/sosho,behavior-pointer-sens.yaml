## dts/bindings/behaviors/sosho,behavior-pointer-sens.yaml
```yaml
# SPDX-License-Identifier: MIT

description: |
  ポインタ感度(パーセント)をキーマップ上に保持するためだけのビヘイビア。
  押しても何も起きない。値は sosho,input-processor-pointer-sens が読む。

compatible: "sosho,behavior-pointer-sens"

include: one_param.yaml
```

## dts/bindings/input_processors/sosho,input-processor-pointer-sens.yaml
```yaml
# SPDX-License-Identifier: MIT

description: |
  キーマップ上の sosho,behavior-pointer-sens の値(パーセント)で X/Y の移動量を拡縮する。
  param1 はスロット番号で、設定用レイヤーの何番目のキーを読むかを表す
  (0 = トラックボール、1 = トラックパッド)。

compatible: "sosho,input-processor-pointer-sens"

include: ip_one_param.yaml
```
